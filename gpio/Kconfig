## gpio/Kconfig
```kconfig
menu "Motor GPIO Configuration"

    config LEFT_MOTOR_FORWARD
        int "Left motor forward"
        default 33

    config LEFT_MOTOR_REVERSE
        int "Left motor reverse"
        default 25


    config RIGHT_MOTOR_FORWARD
        int "Right motor direction pin"
        default 26

    config RIGHT_MOTOR_REVERSE
        int "Right motor direction pin"
        default 27

endmenu
```

## pwm/Kconfig
```kconfig
menu "PWM configuration"

    config LM_PWM_GPIO
        int "Left motor GPIO"
        default 32

    config RM_PWM_GPIO
        int "Right motor GPIO"
        default 21
        
endmenu
```

## sdkconfig.defaults
```kconfig
#Enables WebSocket in HTTPD server component
CONFIG_HTTPD_WS_SUPPORT=y

# Add all debug logs into compiled source files
CONFIG_LOG_DEFAULT_LEVEL_DEBUG=y

# Set the actual logging verbosity level (3=INFO, 4=DEBUG)
CONFIG_LOG_DEFAULT_LEVEL=4

CONFIG_LOG_MAXIMUM_LEVEL=4
```

## wifi/Kconfig
```kconfig
menu "Configure WiFi"

    config WIFI_SSDI
        string "WiFi SSDI"
        default "defaultSSDI"

    config WIFI_PASSWORD
        string "WiFi Password"
        default "defaultPASSWOR"
endmenu
```
